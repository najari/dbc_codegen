AUTOSAR XML (schema 4-2-1)
standard types defined: uint8
package /Communication/NetworkManagement
  nm config NMConfig_GEMMY23: can-nm-cluster-coupling{coupled-cluster=CCB, nm-busload-reduction-enabled=false, nm-immediate-restart-enabled=false}
    can nm cluster CCB:
      communication-cluster=CCB
      nm-channel-sleep-master=true
      nm-synchronizing-network=false
      nm-busload-reduction-active=false
      nm-car-wake-up-filter-enabled=false
      nm-car-wake-up-rx-enabled=false
      nm-cbv-position=1
      nm-channel-active=false
      nm-immediate-nm-cycle-time=0.01
      nm-immediate-nm-transmissions=15
      nm-message-timeout-time=0.5
      nm-msg-cycle-time=0.64
      nm-network-timeout=4
      nm-nid-position=0
      nm-remote-sleep-indication-time=0
      nm-repeat-message-time=1.5
      nm-user-data-length=6
      nm-wait-bus-sleep-time=4
      can nm node IDCM_A_CCB: controller=IDCM_A_CCB_Controller, nm-if-ecu=IDCM_A, nm-node-id=111, nm-passive-mode-enabled=false, nm-msg-cycle-offset=0.03, nm-range-config={lower-can-id=1536, upper-can-id=1663}
    nm-if-ecus:
      nm ecu IDCM_A: ecu-instance=IDCM_A, nm-bus-synchronization-enabled=false, nm-com-control-enabled=false, nm-coordinator={nm-active-coordinator=false, nm-shutdown-delay-timer=0}, nm-node-detection-enabled=false, nm-node-id-enabled=true, nm-passive-mode-enabled=false, nm-pdu-rx-indication-enabled=true, nm-remote-sleep-ind-enabled=false, nm-repeat-msg-ind-enabled=false, nm-state-change-ind-enabled=false, nm-user-data-enabled=true
package /Communication/PDUs
  i signal i pdu group IDCM_A_CCB_Tx: communication-direction=OUT, i-signal-i-pdus=Test_Frame
package /DataConstraints
  range IC_CIBAutoBrkReq_RedntAntiRplyCnt_IDCM_A_CIB_Autonomous_Braking_Req_IDCM_A_Redundant_0DA_M: raw 
  range IC_CIBAutoBrkReq_RedntMAC_IDCM_A_CIB_Autonomous_Braking_Req_IDCM_A_Redundant_0DA_M: raw 
package /DataTypes/Units
  unit NoUnit: display-name=NoUnit, factor-si-to-unit=0, offset-si-to-unit=0
package /System
  system System: category=ECU_SYSTEM_DESCRIPTION
package /Topology/Clusters
  can cluster CCB: baudrate=500000, can-fd-baudrate=2000000
    can physical channel CCB: comm-connectors=IDCM_A_CCB
      frame Test_Frame: id 0xDA, from IDCM_A, frame-length=2, can-addressing-mode=STANDARD, can-frame-rx-behavior=CAN-FD, can-frame-tx-behavior=CAN-FD
        carries pdu Test_Frame: packing-byte-order=big-endian, start-position=7
        pdu Test_Frame: length=2, minimum-delay=0, transmission-mode-true-timing=cyclic-timing={time-offset=0, time-period=0.1}, unused-bit-pattern=0
          transmission-mode-conditions:
            data-filter=data-filter-type=ALWAYS, i-signal-in-i-pdu=Message_1
            data-filter=data-filter-type=ALWAYS, i-signal-in-i-pdu=Message_2
          signal IMessage_2: start 7, 7 bit, big-endian, init-value=0, base-type=uint8, compu {phys=raw for raw 0..127}, transfer-property=PENDING  # Message 2
          signal IMessage_1: start 15, 5 bit, big-endian, init-value=0, base-type=uint8, compu {phys=raw for raw 0..31}, transfer-property=PENDING  # Message 1
package /Topology/HardwareComponents
  ecu instance IDCM_A: associated-com-i-pdu-group=IDCM_A_CCB_Tx, sleep-mode-supported=false, wake-up-over-bus-supported=false
    can communication controller IDCM_A_CCB_Controller: can-controller-attributes=can-controller-configuration={can-controller-fd-attributes={padding-value=85, prop-seg=23, sync-jump-width=8, time-seg-1=8, time-seg-2=8, trcv-delay-compensation-offset=4E-7, tx-bit-rate-switch=true}, prop-seg=23, sync-jump-width=8, time-seg-1=8, time-seg-2=8}
    can communication connector IDCM_A_CCB: comm-controller=IDCM_A_CCB_Controller
