AUTOSAR XML (schema 4-2-1)
package /MY_PLATFORM
  system System: pnc-vector-length=0, pnc-vector-offset=0
    system mapping System_Mappings
package /Cluster
  can cluster MY_CLUSTER: baudrate=500000, protocol-name=CAN, protocol-version=2.0
    can physical channel CHNL: comm-connectors=CN_MY_CLUSTER
      frame MY_MESSAGE_XIX_MY_CLUSTER: id 0x5F0, frame-length=8, can-addressing-mode=STANDARD, can-frame-rx-behavior=CAN-20, can-frame-tx-behavior=CAN-20
        pdu MY_MESSAGE_XIX_MY_CLUSTER: length=8, minimum-delay=0.05, transmission-mode-condition{data-filter=data-filter-type=ALWAYS, i-signal-in-i-pdu=MY_SIGNAL}, transmission-mode-true-timing={cyclic-timing={time-offset=0.0, time-period=0.2}, event-controlled-timing=number-of-repetitions=0}, unused-bit-pattern=0
          signal MY_SIGNAL_XIX_MY_MESSAGE_XIX_MY_CLUSTER: start 15, 1 bit, little-endian, data-type-policy=OVERRIDE, init-value=0, base-type=BT_MY_SIGNAL, compu {}, transfer-property=TRIGGERED-ON-CHANGE-WITHOUT-REPETITION
package /BaseType
  base type BT_MY_SIGNAL: category=FIXED_LENGTH, base-type-size=1, base-type-encoding=NONE, byte-order=little-endian
