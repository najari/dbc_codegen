VERSION "FanSimulationExample"

NS_ :

BS_:

BU_: ClimateController FanController HMI

BO_ 256 TemperatureData: 8 ClimateController
 SG_ AverageTemperature : 0|16@1+ (0.1,-40) [-40|215.3] "degC" FanController

BO_ 257 FanControl: 8 HMI
 SG_ FanMode : 0|8@1+ (1,0) [0|2] "" FanController
 SG_ TargetTemperature : 8|8@1+ (1,0) [0|100] "degC" FanController

BO_ 258 FanStatus: 8 FanController
 SG_ FanSpeed : 0|16@1+ (1,0) [0|6000] "rpm" ClimateController,HMI
 SG_ FanActive : 16|1@1+ (1,0) [0|1] "" ClimateController,HMI

CM_ BO_ 256 "Provides the temperature input used to calculate the target fan speed.";
CM_ SG_ 256 AverageTemperature "Maps to TemperatureSimulation.temperatureControlConsumedDO.averageTemperature.";
CM_ BO_ 257 "Runtime control settings for the fan simulation.";
CM_ SG_ 257 FanMode "Fan control mode: Off, On, Auto.";
CM_ SG_ 257 TargetTemperature "Target temperature used by fan control logic.";
CM_ BO_ 258 "Published fan controller state.";
CM_ SG_ 258 FanSpeed "Maps to FanSimulation.fanProvidedDO.fanSpeed in RPM.";
CM_ SG_ 258 FanActive "1 while FanSpeed is greater than zero.";

VAL_ 257 FanMode 0 "Off" 1 "On" 2 "Auto";
VAL_ 258 FanActive 0 "Off" 1 "On";
